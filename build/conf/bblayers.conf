## build/conf/bblayers.conf
```bitbake
# POKY_BBLAYERS_CONF_VERSION is increased each time build/conf/bblayers.conf
# changes incompatibly
POKY_BBLAYERS_CONF_VERSION = "2"

BBPATH = "${TOPDIR}"
BBFILES ?= ""

BBLAYERS ?= " \
  /home/xuning/poky-rk3506-evm/poky/meta-rockchip \
  /home/xuning/poky-rk3506-evm/poky/meta \
  /home/xuning/poky-rk3506-evm/poky/meta-poky \
  /home/xuning/poky-rk3506-evm/poky/meta-yocto-bsp \
  /home/xuning/poky-rk3506-evm/poky/meta-openembedded/meta-oe \
  /home/xuning/poky-rk3506-evm/poky/meta-openembedded/meta-python \
  /home/xuning/poky-rk3506-evm/poky/meta-qt5 \
  "
```

## meta-rockchip/conf/machine/rockchip-rk3506-evb-dsi.conf
```bitbake
# Copyright (c) 2024, Rockchip Electronics Co., Ltd
# Released under the MIT license (see COPYING.MIT for the terms)

#@TYPE: Machine
#@NAME: RK3506 EVB with MIPI DSI Display
#@DESCRIPTION: RK3506 EVB board with 480x800 MIPI DSI display (ST7701 controller)

require conf/machine/include/rk3506.inc

# Device tree for DSI display configuration
KERNEL_DEVICETREE = "rockchip/rk3506g-evb1-v10-dsi.dtb"

# U-Boot configuration
UBOOT_MACHINE = "rk3506_defconfig"
RK_UBOOT_SPL = "1"

# Display-specific settings
MACHINEOVERRIDES =. "rk3506-dsi:"

# Optional: Add description for documentation
MACHINE_FEATURES:append = " dsi-display"
```

## meta-rockchip/conf/machine/rockchip-rk3506-evb-rgb.conf
```bitbake
# Copyright (c) 2024, Rockchip Electronics Co., Ltd
# Released under the MIT license (see COPYING.MIT for the terms)

#@TYPE: Machine
#@NAME: RK3506 EVB with RGB888 Display
#@DESCRIPTION: RK3506 EVB board with RGB888 parallel display interface

require conf/machine/include/rk3506.inc

# Device tree for RGB888 display configuration
KERNEL_DEVICETREE = "rockchip/rk3506g-evb1-v10-rgb.dtb"

# U-Boot configuration
UBOOT_MACHINE = "rk3506_defconfig"
RK_UBOOT_SPL = "1"

# Display-specific settings
MACHINEOVERRIDES =. "rk3506-rgb:"

# Optional: Add description for documentation
MACHINE_FEATURES:append = " rgb-display"
```

## meta-rockchip/conf/machine/rockchip-rk3506-evb-spi.conf
```bitbake
# Copyright (c) 2024, Rockchip Electronics Co., Ltd
# Released under the MIT license (see COPYING.MIT for the terms)

#@TYPE: Machine
#@NAME: RK3506 EVB with SPI Display
#@DESCRIPTION: RK3506 EVB board with SPI display interface (ST7789V controller, 240x320 resolution)

require conf/machine/include/rk3506.inc

# Device tree for SPI display configuration
KERNEL_DEVICETREE = "rockchip/rk3506g-evb1-v10-spi.dtb"

# U-Boot configuration
UBOOT_MACHINE = "rk3506_defconfig"
RK_UBOOT_SPL = "1"

# Display-specific settings
MACHINEOVERRIDES =. "rk3506-spi:"

# Optional: Add description for documentation
MACHINE_FEATURES:append = " spi-display"
```
